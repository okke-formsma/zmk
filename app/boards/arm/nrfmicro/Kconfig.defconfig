## app/boards/arm/nrfmicro/Kconfig.defconfig
```kconfig
# Electronut Labs Papyr board configuration

# Copyright (c) 2020 Pete Johanson, Okke Formsma, joric
# SPDX-License-Identifier: MIT

if BOARD_NRFMICRO

config BOARD
	default "nrfmicro"

if USB

config USB_NRFX
	default y

config USB_DEVICE_STACK
	default y

endif # USB

config BT_CTLR
	default BT

config ZMK_BLE
	default y

config ZMK_USB
	default y

config PINMUX
	default y
	
endif # BOARD_NRFMICRO
```

## app/dts/bindings/behaviors/zmk,behavior-chord.yaml
```yaml
# Copyright (c) 2020, Cody McGinnis; Okke Formsma
# SPDX-License-Identifier: MIT

description: Combo behavior

compatible: "zmk,behavior-combo"

properties:
  bindings:
    type: phandle-array
    required: true
  key_positions:
    type: array
    required: true
  timeout_ms:
    type: int
    default: 50
  label:
    type: string
    required: true
  "#binding-cells":
    type: int
    default: 0
    const: 0
```

## app/dts/bindings/behaviors/zmk,behavior-combo.yaml
```yaml
# Copyright (c) 2020, Cody McGinnis; Okke Formsma
# SPDX-License-Identifier: MIT

description: Combo behavior

compatible: "zmk,behavior-combo"

properties:
  bindings:
    type: phandle-array
    required: true
  "#binding-cells":
    type: int
    default: 1
    const: 1
  key-positions:
    type: array
    required: true
  timeout-ms:
    type: int
    default: 50
  slow-release:
    type: boolean
  label:
    type: string
    required: true
```

## app/dts/bindings/behaviors/zmk,behavior-mouse-scroll.yaml
```yaml
description: Mouse scroll

compatible: "zmk,behavior-mouse-scroll"

include: one_param.yaml
```

## app/dts/bindings/behaviors/zmk,behavior-okke.yaml
```yaml
# Copyright (c) 2020, Okke Formsma
# SPDX-License-Identifier: MIT

description: Okke's tap-hold behavior

compatible: "zmk,behavior-okke"

include: zero_param.yaml

properties:
  bindings:
    type: phandle-array
    required: true
  tapping_term_ms:
    type: int
```
